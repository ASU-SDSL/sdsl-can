## sdsl-can-lib/Kconfig
```kconfig
menuconfig SDSL_CAN
    bool "SDSL CAN library"
    select CAN
    select ISOTP
    select NANOPB
    help
      Enable the SDSL CAN link library.

if SDSL_CAN

config CAN_LINK_NODE_ADDR
    hex "Local CAN node address"
    default 0x02
    range 0x01 0xFE

config CAN_LINK_PEER_NODE_ADDR
    hex "Peer CAN node address"
    default 0x01
    range 0x01 0xFE

config CAN_LINK_LOOPBACK
    bool "Enable CAN loopback mode"
    default n

config CAN_LINK_DISABLE_UNICAST_RX
    bool "Disable unicast RX worker"
    default n

config CAN_LINK_DISABLE_BROADCAST_RX
    bool "Disable broadcast RX worker"
    default n

endif
```

## sdsl-can-lib/tests/eps_message_zephyr_isotp_duplex_test/Kconfig
```kconfig
mainmenu "EPS Message Zephyr ISO-TP Duplex Test"

source "Kconfig.zephyr"

menu "EPS message Zephyr ISO-TP duplex test options"

config CAN_LINK_TX_PERIOD_MS
    int "TX period in milliseconds"
    default 1500
    range 10 60000

config CAN_LINK_TX_START_OFFSET_MS
    int "Additional TX start offset in milliseconds"
    default 0
    range 0 60000

endmenu
```
